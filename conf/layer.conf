## conf/layer.conf
```bitbake
# We have a conf and classes directory, add to BBPATH
BBPATH .= ":${LAYERDIR}"

# We have recipes-* directories, add to BBFILES
BBFILES += "${LAYERDIR}/recipes-*/*/*.bb \
	${LAYERDIR}/recipes-*/*/*.bbappend"

BBFILE_COLLECTIONS += "meta-ori"
BBFILE_PATTERN_meta-ori = "^${LAYERDIR}/"
BBFILE_PRIORITY_meta-ori = "7"
LAYERSERIES_COMPAT_meta-ori = "zeus"

# For petalinux-image-minimal
# IMAGE_INSTALL_append = " nbd-client nbd-server"

# For petalinux-initramfs-image
INITRAMFS_PACKAGES_append = " nbd-client nbd-server "
#INITRAMFS_SCRIPTS_append = " initramfs-framework-nbdrootfs "
```
